## applications/matter-aliro-door-lock-app/src/display/Kconfig
```kconfig
#
# Copyright (c) 2026 Nordic Semiconductor ASA
#
# SPDX-License-Identifier: LicenseRef-Nordic-5-Clause
#

config DISPLAY_THREAD_PRIORITY
	int "Maximum length of single command in Bytes"
	default 11
	help
	  Priority of the display thread.

config DISPLAY_THREAD_STACK_SIZE
	int "Stack size of the display thread"
	default 4096
	help
	  Stack size of the display thread.
```

## subsys/aliro/disambiguation/Kconfig
```kconfig
#
# Copyright (c) 2026 Nordic Semiconductor ASA
#
# SPDX-License-Identifier: LicenseRef-Nordic-5-Clause
#

menuconfig DOOR_LOCK_ALIRO_UWB_DISAMBIGUATION
	bool "UWB front/back disambiguation [EXPERIMENTAL]"
	depends on DOOR_LOCK_ALIRO_UWB
	depends on QM35_UWB_ALIRO_ZEPHYR
	select Q_ALIRO_DISAMBIGUATION
	select EXPERIMENTAL
	help
	  Enable the front/back disambiguation algorithm (CIR, distance, and PDOA processing).

if DOOR_LOCK_ALIRO_UWB_DISAMBIGUATION

config DOOR_LOCK_ALIRO_UWB_DISAMBIGUATION_MAX_CIR
	int "Max CIR threshold for disambiguation"
	default 1500
	range 100 5000
	help
	  Maximum CIR value used to calculate p_ratio. Higher values retain more
	  radar samples.

config DOOR_LOCK_ALIRO_UWB_DISAMBIGUATION_P_RATIO
	int "Lower p_ratio bound for radar evidence"
	default 1500
	range 1 30000
	help
	  p_ratio at or below this value produces no FRONT evidence. The value is
	  divided by 10000; values up to P_RATIO_FULL are mapped linearly.

config DOOR_LOCK_ALIRO_UWB_DISAMBIGUATION_P_RATIO_FULL
	int "p_ratio yielding full radar evidence"
	default 5000
	range 2 30000
	help
	  p_ratio at or above this value produces full FRONT evidence. The value
	  is divided by 10000 and must be greater than P_RATIO.

config DOOR_LOCK_ALIRO_UWB_DISAMBIGUATION_NB_BLOCKS
	int "Max noise blocks threshold for disambiguation"
	default 12
	range 0 40
	help
	  Maximum number of low-amplitude blocks allowed for a FRONT decision.

config DOOR_LOCK_ALIRO_UWB_DISAMBIGUATION_NOISE_THRESHOLD
	int "Noise block amplitude threshold"
	default 8
	range 1 100
	help
	  CIR magnitude below which a block is classified as noise.

config DOOR_LOCK_ALIRO_UWB_DISAMBIGUATION_SHADOW_THRESHOLD
	int "Shadow noise block amplitude threshold"
	default 8
	range 1 100
	help
	  CIR magnitude below which a shadow-region block is classified as noise.

config DOOR_LOCK_ALIRO_UWB_DISAMBIGUATION_BLIND_DISTANCE_CM
	int "Blind distance (cm) below which disambiguation is disabled"
	default 30
	range 0 100
	help
	  Minimum distance for the algorithm to engage. Below this value the
	  result is unreliable (too close to the antenna).

config DOOR_LOCK_ALIRO_UWB_DISAMBIGUATION_SECURE_BUBBLE_CM
	int "Secure bubble radius (cm) for door open confirmation"
	default 150
	range 10 200
	help
	  Door open is confirmed only when the user is within this distance.
	  Acts as a final gate after FRONT is detected.

config DOOR_LOCK_ALIRO_UWB_DISAMBIGUATION_EWMA_ALPHA
	int "EWMA smoothing factor (permille, 1-1000)"
	default 150
	range 1 1000
	help
	  EWMA alpha multiplied by 1000. Lower values are slower and more stable.

config DOOR_LOCK_ALIRO_UWB_DISAMBIGUATION_FRONT_SCORE_THRESHOLD
	int "EWMA score threshold to switch BACK→FRONT (permille, 1-999)"
	default 650
	range 1 999
	help
	  Score required to switch from BACK to FRONT. Must be greater than
	  BACK_SCORE_THRESHOLD.

config DOOR_LOCK_ALIRO_UWB_DISAMBIGUATION_BACK_SCORE_THRESHOLD
	int "EWMA score threshold to switch FRONT→BACK (permille, 1-999)"
	default 350
	range 1 999
	help
	  Score below which FRONT switches to BACK. Must be less than
	  FRONT_SCORE_THRESHOLD.

config DOOR_LOCK_ALIRO_UWB_DISAMBIGUATION_PDOA_OFFSET_DEG
	int "PDOA calibration offset (degrees)"
	default 0
	range -180 180
	help
	  PDOA offset in degrees subtracted from raw PDOA before feeding the
	  disambiguation algorithm. Compensates for antenna placement.

config DOOR_LOCK_ALIRO_UWB_DISAMBIGUATION_DISTANCE_OFFSET_CM
	int "Distance calibration offset (cm)"
	default 0
	range -200 200
	help
	  Distance offset in cm subtracted from raw UWB range measurements
	  before feeding the disambiguation algorithm. Compensates for
	  systematic ranging bias.

config DOOR_LOCK_ALIRO_UWB_DISAMBIGUATION_UWB_RSL_DROP_DB
	int "UWB RSL drop threshold for phone-behind-door veto (dB, 1-30)"
	default 5
	range 1 30
	help
	  RSL drop from the confirmed FRONT reference that vetoes a FRONT result.

config DOOR_LOCK_ALIRO_UWB_DISAMBIGUATION_UWB_RSL_ALPHA
	int "UWB RSL EWMA smoothing factor (permille, 1-1000)"
	default 300
	range 1 1000
	help
	  EWMA alpha multiplied by 1000 for smoothing UWB RSL samples.

config DOOR_LOCK_ALIRO_UWB_DISAMBIGUATION_UWB_RSL_MAX_FRONT_DB
	int "Cold-start RSL level that blocks FRONT (dBm magnitude, 50-100)"
	default 73
	range 50 100
	help
	  RSL magnitude at or above which FRONT is blocked during cold start.

config DOOR_LOCK_ALIRO_UWB_DISAMBIGUATION_UWB_RSL_FRONT_ENABLE_DB
	int "Cold-start RSL level that enables FRONT (dBm magnitude, 50-100)"
	default 71
	range 50 100
	help
	  RSL magnitude at or below which FRONT is enabled during cold start.
	  Must be lower than UWB_RSL_MAX_FRONT_DB.

module = DOOR_LOCK_ALIRO_UWB_DISAMBIGUATION
module-str = "UWB disambiguation"
module-dep = LOG
source "$(ZEPHYR_BASE)/subsys/logging/Kconfig.template.log_config"

endif # DOOR_LOCK_ALIRO_UWB_DISAMBIGUATION
```
